## conf/distro/mansion.conf
```bitbake
#@NAME: mansion
#@DESCRIPTION: Mansion distribution based on OpenSTLinux Scarthgap

require include/st-default-distro-rules.inc
require include/st-default-distro-providers.inc
require include/openstlinux.inc

DISTRO = "mansion"
DISTRO_NAME = "Mansion Linux"
DISTRO_VERSION = "1.0"

# Keep Weston/Wayland model
DISTRO_FEATURES:append = " opengl gplv3 "
DISTRO_FEATURES:remove = " x11 "

# Enable GPU features when available
DISTRO_FEATURES:append = " ${@bb.utils.filter('MACHINE_FEATURES', 'vulkan opencl', d)} "

EXTRA_IMAGE_FEATURES += " debug-tweaks"

# conf/distro/mansion.conf
DISTRO_EXTRA_RDEPENDS:append = " busybox"
```
